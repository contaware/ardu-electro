/*
  LAN8720 ethernet module web server on ESP32
  
  - LAN8720 operates at 3.3V.
  
  - LAN8720 uses the RMII (Reduced Media Independent Interface) to 
    communicate with the ESP32 (ESP32-S2, ESP32-S3, ... do not support 
    RMII).

  - Fixed pin assignments:
  
    ESP32      LAN8720 module
    -----      --------------

    GPIO21 <-> TX-EN
    GPIO19 <-> TX0
    GPIO22 <-> TX1
    GPIO25 <-> RX0
    GPIO26 <-> RX1
    GPIO27 <-> CRS

  - Configurable pin assignments:
  
    ESP32      LAN8720 module
    -----      --------------

    GPIO23 <-> MDC
    GPIO18 <-> MDIO

  - There are two possibilities for the clock source:

    MOD-A. GPIO0 can accept the clock from the external oscillator of 
           the LAN8720 module. The problem is that the GPIO0 is sensed 
           at boot time by the ESP32, and if it is pulled LOW, the 
           bootloader awaits serial programming. So it has to be held 
           HIGH during boot by:
           1. GPIO0 must be connected to a 4k7 pull-up.
           2. Choose a GPIOx pin and solder it to the enable/tri-state 
              pin1 of the LAN8720 module's 50MHz oscillator. Add a 4k7 
              pull-down.
           3. ETH.begin()'s power parameter must be set to this GPIOx.
       
           ESP32      LAN8720 module
           -----      --------------

           GPIO0  <-> nINT/REFCLK
           GPIOx  <-> enable pin1 of LAN8720 module's 50MHz oscillator
       
    MOD-B. GPIO16, GPIO17 (also GPIO0) can generate the clock for the 
           LAN8720 module. It's better to avoid GPIO0 because it is a 
           strapping pin (see above). Consider using either GPIO16 or 
           GPIO17. GPIO17 has an inverted clock output and works best 
           with the LAN8720. As the clock is generated by the ESP32, we 
           must disable the 50MHz oscillator on the LAN8720 module by 
           soldering its enable/tri-state pin1 to LOW, or de-solder the 
           oscillator. ETH.begin()'s power parameter must be set to -1.
       
           ESP32      LAN8720 module
           -----      --------------

           GPIO17 <-> nINT/REFCLK
       
           Warning: the GPIO16 and GPIO17 pins cannot be used on boards 
                    that employ an ESP32-WROVER because they are needed 
                    to talk to the PSRAM.
*/
#include <ETH.h>
// - For static IP set the define to true and fill the 
//   wanted IP in onEvent() under ARDUINO_EVENT_ETH_START 
// - For dynamic IP set the define to false
#define USE_STATIC_IP                   true
#define LISTEN_PORT                     80
#define MAX_CLIENTS                     4
NetworkServer server(LISTEN_PORT, MAX_CLIENTS);
const unsigned long clientCloseWaitMs = 1; // give the web browser time to receive the data
const char* hostname =                  "esp32-ethernet";
bool eth_connected = false;

// Ethernet event handler
void onEvent(arduino_event_id_t event, arduino_event_info_t info)
{
  switch (event)
  {
    case ARDUINO_EVENT_ETH_START:
    {
      Serial.println("ETH Started");
      // The hostname and the static IP must be set here
      ETH.setHostname(hostname);
#if USE_STATIC_IP == true
      IPAddress ip(192, 168, 1, 28);       // Arduino IP
      IPAddress dns(192, 168, 1, 1);       // DNS server
      IPAddress gateway(192, 168, 1, 1);   // network gateway
      IPAddress subnet(255, 255, 255, 0);  // subnet mask of the network
      ETH.config(ip, gateway, subnet, dns);
#endif
      break;
    }

    case ARDUINO_EVENT_ETH_CONNECTED:
      Serial.println("ETH Connected");
      break;

    case ARDUINO_EVENT_ETH_GOT_IP:
      Serial.print(ETH);
      Serial.printf("Hostname: %s\n\n", ETH.getHostname());
      eth_connected = true;
      break;

    case ARDUINO_EVENT_ETH_LOST_IP:
      Serial.println("ETH Lost IP");
      eth_connected = false;
      break;

    case ARDUINO_EVENT_ETH_DISCONNECTED:
      Serial.println("ETH Disconnected");
      eth_connected = false;
      break;

    case ARDUINO_EVENT_ETH_STOP:
      Serial.println("ETH Stopped");
      eth_connected = false;
      break;

    default:
      break;
  }
}
 
void setup()
{
  // Init Serial (leave Serial Monitor open to see all messages)
  Serial.begin(9600); delay(5000); // wait 5s that Serial is ready

  // Init ethernet
  Network.onEvent(onEvent);
  ETH.begin(ETH_PHY_LAN8720,       // ETH_PHY_LAN8720
            1,                     // PHY address: 0 or 1
            23,                    // Pin# of the PHY MDC signal
            18,                    // Pin# of the PHY MDIO signal
            -1,                    // Pin# ETH_PHY_POWER (-1 if not needed)
            ETH_CLOCK_GPIO17_OUT); // ETH_CLOCK_GPIO0_IN:   GPIO0 is the input for the external 50MHz clock from the crystal oscillator
                                   // ETH_CLOCK_GPIO0_OUT:  50MHz clock from internal APLL and output on GPIO0
                                   // ETH_CLOCK_GPIO16_OUT: 50MHz clock from internal APLL and output on GPIO16
                                   // ETH_CLOCK_GPIO17_OUT: 50MHz clock from internal APLL inverted and output on GPIO17
}
 
void loop()
{
  if (eth_connected)
  {
    // Init web server
    if (!server)
    {
      server.begin();
      Serial.printf("Listen on port %d\n", LISTEN_PORT);
    }

    // Listen for incoming clients
    NetworkClient client = server.accept();
    if (client)
    {
      bool currentLineIsBlank = true;
      while (client.connected())   // loop as long as the client is connected
      {
        if (client.available())    // if there are bytes to read from the client
        {
          char c = client.read();
          Serial.write(c);
          
          // If we have gotten to the end of the line (received a newline
          // character) and the line is blank, the HTTP request has ended
          // and we can send a reply
          if (c == '\n' && currentLineIsBlank)
          {
              client.println("HTTP/1.1 200 OK");
              client.println("Content-type: text/html");
              client.println();
              client.print("<h1>WebSrv</h1>");
              client.print("<p>Current millis(): ");
              client.print(millis());
              client.print("</p>");
              client.println();
              break;               // exit the while loop and jump to the below close connection command 
          }
          else if (c == '\n')      // starting a new line
            currentLineIsBlank = true;
          else if (c != '\r')      // we have gotten a character on the current line
            currentLineIsBlank = false;
        }
      }
      delay(clientCloseWaitMs);    // give the web browser time to receive the data
      client.stop();               // close the connection
    }
  }
}
